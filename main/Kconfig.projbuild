## main/Kconfig.projbuild
```kconfig
menu "Board Behavior"
    config AIRBRAKE_COMPUTER
        bool "Does the computer control the airbrakes"
        default n
    config GYRO_CALIB
        bool "Should run gyro calibration"
        default n
    config USE_GYRO_CALIB
        bool "Should use gyro calibrations"
        default y
    config FAIL_ON_NO_SD
        bool "Should the computer fail to start if no SD is inserted"
        default y if !AIRBRAKE_COMPUTER
        default n 
    config GROUND_TEST
        bool "Are we running a ground test (meaning state machine only bases transitions off barometer data)"
        default n
endmenu

menu "State Machine Settings"
    config ACCEL_BOOST
        float "How much does the magnitude of acceleration have to change by before we transition to boost"
        default 29.4 
        # 3g
    config ACCEL_COAST_DIFF
        float "How much does the magnitude of acceleration have to change by before we transition to coast"
        default -34.3
        # -3.5g
    config APOGEE_WINDOW
        int "how long after min pressure do we say we've detected apogee, in ms"
        default 500
        help
            This should be depreacted after we have a full Kalman filter system
    config COAST_ALTITUDE
        float "Altitude where we enter coast (estimate), in meters"
        default 1480 
        # from the irec openrocket sim (nov 15th)
    config COAST_TIME
        float "How long we expect to stay in coast, in ms"
        default 6000
    config STANDBY_TIME
        int "How long we hold in standby for, at a minimum (ms)"
        default 10000
endmenu
```
